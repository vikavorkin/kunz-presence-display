## sdkconfig.defaults
```kconfig
# WiFi
CONFIG_ESP32_WIFI_ENABLED=y
CONFIG_ESP_WIFI_SOFTAP_SUPPORT=y

# NVS
CONFIG_NVS_ENCRYPTION=n

# TLS / HTTPS for Telegram
CONFIG_ESP_TLS_USING_MBEDTLS=y
CONFIG_MBEDTLS_CERTIFICATE_BUNDLE=y
CONFIG_MBEDTLS_CERTIFICATE_BUNDLE_DEFAULT_FULL=y
CONFIG_ESP_HTTPS_OTA_ALLOW_HTTP=n

# OTA — two-partition table so OTA updates are possible
CONFIG_PARTITION_TABLE_TWO_OTA=y

# HTTP client
CONFIG_ESP_HTTP_CLIENT_ENABLE_HTTPS=y

# HTTP server
CONFIG_HTTPD_MAX_REQ_HDR_LEN=1024
CONFIG_HTTPD_MAX_URI_LEN=512

# Stack sizes
CONFIG_MAIN_TASK_STACK_SIZE=8192
CONFIG_ESP_SYSTEM_EVENT_TASK_STACK_SIZE=4096

# Logging
CONFIG_LOG_DEFAULT_LEVEL_INFO=y
```
